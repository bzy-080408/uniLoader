## configs/mha_defconfig
```kconfig
CONFIG_COMPRESS_GZIP=y
CONFIG_LINUX_KRNL_HEADER_IMG=y
CONFIG_SIMPLE_FB=y
CONFIG_EARLYCON=y
CONFIG_HI3660=y
CONFIG_HUAWEI_MHA=y
CONFIG_TEXT_BASE=0x00080000
CONFIG_PAYLOAD_ENTRY=0x05000000
CONFIG_RAMDISK_ENTRY=0x07C00000
CONFIG_RAMDISK_NO_COPY=y
```
